
#include "interrupt.h"


/***********************************************************************************
函数功能: Irq中断服务函数.
入口参数: none.
返 回 值: none.
***********************************************************************************/
void ISR_IrqIsr(void)
{
    U32 uiIrqStatus;

    /* 读取产生中断的IRQ中断源 */
    uiIrqStatus = IRQSTA;

    /* Timer中断 */
    if(TIME1INTMASK == (TIME1INTMASK & uiIrqStatus))
    {
        /* Tick中断函数 */
        ISR_TickIsr();

        /* 清除tick定时器中断标志 */
        T1CLRI = 0;
    }
    /* 外部Irq0中断 */
    else //if(EXTIRQ0INTMASK == (EXTIRQ0INTMASK & uiIrqStatus))
    {
        /* 行人中断函数 */
        ISR_PassengerIsr();
    }
}

/***********************************************************************************
函数功能: Tick中断函数.
入口参数: none.
返 回 值: none.
***********************************************************************************/
void ISR_TickIsr(void)
{
    guiSystemTick++;
}

/***********************************************************************************
函数功能: 行人中断函数.
入口参数: none.
返 回 值: none.
***********************************************************************************/
void ISR_PassengerIsr(void)
{
    /* 将十字路口改变为行人过马路状态 */
    if(CROSSSTATE1 == guiCurSta)
    {
        /* 状态1下触发行人中断, 置为状态2 */
        guiCurSta = CROSSSTATE2;

        /* 置为状态改变 */
        guiStaChange = 1;
    }
    else if((CROSSSTATE3 == guiCurSta) || (CROSSSTATE4 == guiCurSta))
    {
        /* 状态3和状态4下触发行人中断, 置为状态3 */
        guiCurSta = CROSSSTATE3;

        /* 置为状态改变 */
        guiStaChange = 1;
    }
}

/***********************************************************************************
函数功能: 锁行人中断函数.
入口参数: none.
返 回 值: none.
***********************************************************************************/
void ISR_PassengerIntLock(void)
{
    /* 禁止中断 */
    IRQEN &= ~EXTIRQ0INTMASK;
}

/***********************************************************************************
函数功能: 解锁行人中断函数.
入口参数: none.
返 回 值: none.
***********************************************************************************/
void ISR_PassengerIntUnlock(void)
{
    /* 使能中断 */
    IRQEN |= EXTIRQ0INTMASK;
}

